## config/boards/shields/kafka/Kconfig.shield
```kconfig
# Copyright (c) 2022 Duccio Breschi
# SPDX-License-Identifier: MIT

config SHIELD_OPENWORK36_LEFT
    def_bool $(shields_list_contains,openwork_left36)

config SHIELD_OPENWORK36_RIGHT
    def_bool $(shields_list_contains,openwork_right36)
```
